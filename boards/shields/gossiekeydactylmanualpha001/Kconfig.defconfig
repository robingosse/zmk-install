## boards/shields/gossiekeydactylmanualpha001/Kconfig.defconfig
```kconfig
if SHIELD_GOSSIEKEYDACTYLMANUALPHA001_LEFT

config ZMK_KEYBOARD_NAME
    default "GKDMA001"

config ZMK_SPLIT_ROLE_CENTRAL
    default y

endif

if SHIELD_GOSSIEKEYDACTYLMANUALPHA001_LEFT || SHIELD_GOSSIEKEYDACTYLMANUALPHA001_RIGHT

config ZMK_SPLIT
    default y

endif
```

## boards/shields/gossiekeydactylmanualpha001/Kconfig.shield
```kconfig
# SPDX-License-Identifier: MIT

config SHIELD_GOSSIEKEYDACTYLMANUALPHA001_LEFT
    bool "GossieKeyDactylManuAlpha001 Left"

config SHIELD_GOSSIEKEYDACTYLMANUALPHA001_RIGHT
    bool "GossieKeyDactylManuAlpha001 Right"
```
